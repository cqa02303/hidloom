## build/buildroot/hidloom-external/Config.in
```kconfig
menu "HIDloom external packages"
source "$BR2_EXTERNAL_HIDLOOM_PATH/package/hidloom-matrixd/Config.in"
source "$BR2_EXTERNAL_HIDLOOM_PATH/package/hidloom-m3-router/Config.in"
source "$BR2_EXTERNAL_HIDLOOM_PATH/package/python-luma-core/Config.in"
source "$BR2_EXTERNAL_HIDLOOM_PATH/package/python-luma-oled/Config.in"
endmenu
```

## build/buildroot/hidloom-external/configs/hidloom_m1_defconfig
```kconfig
# Buildroot M1 fast-boot experiment for Raspberry Pi Zero 2 W.
# Based on upstream raspberrypizero2w_defconfig, with only the HIDloom M1
# rootfs overlay and USB gadget kernel/config hooks added.
BR2_arm=y
BR2_cortex_a53=y
BR2_ARM_FPU_NEON_VFPV4=y
BR2_TOOLCHAIN_EXTERNAL=y
BR2_TOOLCHAIN_EXTERNAL_BOOTLIN=y
BR2_TOOLCHAIN_EXTERNAL_BOOTLIN_ARMV7_EABIHF_GLIBC_STABLE=y
BR2_GLOBAL_PATCH_DIR="board/raspberrypi/patches"
BR2_DOWNLOAD_FORCE_CHECK_HASHES=y
BR2_ROOTFS_OVERLAY="$(BR2_EXTERNAL_HIDLOOM_PATH)/board/hidloom/rootfs_overlay"
BR2_ROOTFS_POST_BUILD_SCRIPT="board/raspberrypizero2w/post-build.sh"
BR2_ROOTFS_POST_IMAGE_SCRIPT="board/raspberrypizero2w/post-image.sh"
BR2_LINUX_KERNEL=y
BR2_LINUX_KERNEL_CUSTOM_TARBALL=y
BR2_LINUX_KERNEL_CUSTOM_TARBALL_LOCATION="$(call github,raspberrypi,linux,21b410140c47ffab5668399f6f143c7d7b935c8b)/linux-21b410140c47ffab5668399f6f143c7d7b935c8b.tar.gz"
BR2_LINUX_KERNEL_DEFCONFIG="bcm2709"
BR2_LINUX_KERNEL_DTS_SUPPORT=y
BR2_LINUX_KERNEL_INTREE_DTS_NAME="broadcom/bcm2710-rpi-zero-2-w"
BR2_LINUX_KERNEL_CONFIG_FRAGMENT_FILES="$(BR2_EXTERNAL_HIDLOOM_PATH)/board/hidloom/linux-m1-usb-gadget.fragment"
BR2_LINUX_KERNEL_NEEDS_HOST_OPENSSL=y
BR2_PACKAGE_BUSYBOX_SHOW_OTHERS=y
BR2_PACKAGE_XZ=y
BR2_PACKAGE_RPI_FIRMWARE=y
BR2_PACKAGE_RPI_FIRMWARE_BOOTCODE_BIN=y
BR2_PACKAGE_RPI_FIRMWARE_VARIANT_PI=y
BR2_PACKAGE_RPI_FIRMWARE_CONFIG_FILE="$(BR2_EXTERNAL_HIDLOOM_PATH)/board/hidloom/config_zero2w_m1.txt"
BR2_PACKAGE_RPI_FIRMWARE_CMDLINE_FILE="$(BR2_EXTERNAL_HIDLOOM_PATH)/board/hidloom/cmdline_m1.txt"
BR2_PACKAGE_KMOD=y
BR2_PACKAGE_KMOD_TOOLS=y
BR2_TARGET_ROOTFS_EXT2=y
BR2_TARGET_ROOTFS_EXT2_4=y
BR2_TARGET_ROOTFS_EXT2_SIZE="120M"
# BR2_TARGET_ROOTFS_TAR is not set
BR2_PACKAGE_HOST_DOSFSTOOLS=y
BR2_PACKAGE_HOST_GENIMAGE=y
BR2_PACKAGE_HOST_KMOD_XZ=y
BR2_PACKAGE_HOST_MTOOLS=y
```

## build/buildroot/hidloom-external/package/hidloom-m3-router/Config.in
```kconfig
config BR2_PACKAGE_HIDLOOM_M3_ROUTER
	bool "hidloom-m3-router"
	help
	  Minimal M3 matrix event to HID report router.
```

## build/buildroot/hidloom-external/package/hidloom-matrixd/Config.in
```kconfig
config BR2_PACKAGE_HIDLOOM_MATRIXD
	bool "hidloom-matrixd"
	help
	  HIDloom physical GPIO matrix scanner.
```

## build/buildroot/hidloom-external/package/python-luma-core/Config.in
```kconfig
config BR2_PACKAGE_PYTHON_LUMA_CORE
	bool "python-luma-core"
	select BR2_PACKAGE_PYTHON_PILLOW
	select BR2_PACKAGE_PYTHON_SMBUS2
	select BR2_PACKAGE_PYTHON_CBOR2
	help
	  SBC display driver support library used by the M6 OLED daemon.
```

## build/buildroot/hidloom-external/package/python-luma-oled/Config.in
```kconfig
config BR2_PACKAGE_PYTHON_LUMA_OLED
	bool "python-luma-oled"
	select BR2_PACKAGE_PYTHON_LUMA_CORE
	help
	  OLED display drivers used by the M6 I2C status display.
```
